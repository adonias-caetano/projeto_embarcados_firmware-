## components/config_system/Kconfig
```kconfig
menu "Greenhouse Project Configuration"

config DEFAULT_TEMP_SETPOINT
    float "Temperatura de referência padrão"
    default 28.0

config DEFAULT_CONTROL_ENABLED
    bool "Controle inicia habilitado"
    default y

config DEFAULT_LOGGING_ENABLED
    bool "Log inicia habilitado"
    default y

config LOG_INTERVAL_MS
    int "Intervalo de log em ms"
    default 5000

endmenu
```

## sdkconfig.defaults
```kconfig
CONFIG_DEFAULT_TEMP_SETPOINT=28
CONFIG_DEFAULT_CONTROL_ENABLED=y
CONFIG_DEFAULT_LOGGING_ENABLED=y
CONFIG_LOG_INTERVAL_MS=5000

CONFIG_SPIFFS_MAX_PARTITIONS=1
CONFIG_SPIFFS_CACHE=y
CONFIG_SPIFFS_PAGE_SIZE=256
CONFIG_SPIFFS_OBJ_NAME_LEN=32
```
